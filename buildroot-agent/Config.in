## buildroot-agent/Config.in
```kconfig
config BR2_PACKAGE_BUILDROOT_AGENT
	bool "buildroot-agent"
	select BR2_PACKAGE_LIBWEBSOCKETS
	select BR2_PACKAGE_OPENSSL
	help
	  Buildroot Agent - 嵌入式设备远程管理Agent
	  
	  功能特性:
	  - 系统状态采集与上报
	  - 日志文件上传
	  - 远程脚本下发执行
	  - 交互式Shell (PTY)
	  - WebSocket通信 (仅客户端，不暴露端口)
	  
	  https://github.com/your-org/buildroot-agent

if BR2_PACKAGE_BUILDROOT_AGENT

config BR2_PACKAGE_BUILDROOT_AGENT_DEFAULT_SERVER
	string "默认服务器地址"
	default "wss://your-server.com/agent"
	help
	  Agent默认连接的WebSocket服务器地址

config BR2_PACKAGE_BUILDROOT_AGENT_ENABLE_PTY
	bool "启用PTY (远程Shell)"
	default y
	help
	  启用远程交互式Shell功能

config BR2_PACKAGE_BUILDROOT_AGENT_ENABLE_SCRIPT
	bool "启用脚本执行"
	default y
	help
	  启用远程脚本下发和执行功能

endif
```
